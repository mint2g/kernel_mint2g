## drivers/cpufreq/Kconfig.governors
```kconfig
config CPU_FREQ_GOV_LULZACTIVE2
	tristate "'lulzactive' cpufreq governor"
	depends on CPU_FREQ
	help
	  When workload is greater than or equal to 60%, the governor scales up CPU to next higher step. When workload is less than 60%, governor scales down CPU to next lower step. When screen is off, frequency is locked to global scaling minimum frequency.

config CPU_FREQ_GOV_SMARTASS2
	tristate "'smartassV2' cpufreq governor"
	depends on CPU_FREQ
	help
SmartassV2 is a governor (controls the frequency of the CPU at each give moment) which like the first smartass is generally based on the implementation of interactive with some major changes and the addition of a built in sleep profile (behaves a bit differently when screen is off vs. on).The smartassV2 improves the very naive scheme which the first smartass had

config CPU_FREQ_GOV_WHEATLEY
	tristate "'wheatley' cpufreq governor"
	depends on CPU_FREQ
     ---help---
Building on the classic 'ondemand' governor is implemented Wheatley governor. The governor has two additional parameters that control the state.

config CPU_FREQ_GOV_LAGFREE
        tristate "'lagfree' cpufreq governor"
        depends on CPU_FREQ
        ---help---
Lagfree is similar to ondemand. Main difference is it's optimization to become more battery friendly. Frequency is gracefully decreased and increased, unlike ondemand which jumps to 100% too often. Lagfree does not skip any frequency step while scaling up or down. Remember that if there's a requirement for sudden burst of power, lagfree can not satisfy that since it has to raise cpu through each higher frequency step from current. Some users report that video playback using lagfree stutters a little.

config CPU_FREQ_GOV_ONDEMANDX
        tristate "'ondemandX' cpufreq policy governor"
        select CPU_FREQ_TABLE
        ---help---
Basically an ondemand with suspend/wake profiles. This governor is supposed to be a battery friendly ondemand. When screen is off, max frequency is capped at 500 mhz. Even though ondemand is the default governor in many kernel and is considered safe/stable, the support for ondemand/ondemandX depends on CPU capability to do fast frequency switching which are very low latency frequency transitions. 


config CPU_FREQ_GOV_ONDEMANDPLUS
   tristate "'ondemandplus' cpufreq policy governor"
   select CPU_FREQ_TABLE
   help
   The governor does a periodic polling and
   changes frequency based on the CPU utilization.
   The support for this governor depends on CPU capability to
   do fast frequency switching (i.e, very low latency frequency
   transitions).
  
  
config CPU_FREQ_GOV_INTELLIDEMAND
   tristate "'intellidemand' cpufreq policy governor"
   select CPU_FREQ_TABLE
   help
   An intelligent ondemand that enters browsing mode to limit max frequency when GPU is idling, and (exits browsing mode) behaves like ondemand when GPU is busy; to deliver performance for gaming and such. Intellidemand does not jump to highest frequency when screen is off.
 

config CPU_FREQ_GOV_INTELLIACTIVE
   tristate "'intelliactive' cpufreq policy governor"
   help 
Based off Google's Interactive governor with the following enhancements so that the system is more responsive to interactive workloads.

  
config CPU_FREQ_GOV_LIONHEART
   tristate "'lionheart' cpufreq policy governor"
   depends on CPU_FREQ
   ---help---
Lionheart is a conservative-based governor which is based on samsung update3 source. The tunables (such as the thresholds and sampling rate) were changed so the governor behaves more like the performance one, at the cost of battery as the scaling is very aggressive.

config CPU_FREQ_GOV_VIRTUOUS
	tristate "'virtuous' cpufreq policy governor"
	depends on CPU_FREQ
	help
	  Based on smartassv2, sets the max cpu for wake and sleep and changes the governor when your device is awake or asleep. It saves battery by lowering cpu frequencies while the device sleeps, when it awakes it automatically speeds it up again. Or alternately you can set the cpu.
```

## drivers/hwspinlock/Kconfig
```kconfig
#
# Generic HWSPINLOCK framework
#

config HWSPINLOCK
	tristate "Generic Hardware Spinlock framework"
	depends on ARCH_OMAP4 || ARCH_SC8825
	help
	  Say y here to support the generic hardware spinlock framework.
	  You only need to enable this if you have hardware spinlock module
	  on your system (usually only relevant if your system has remote slave
	  coprocessors).

	  If unsure, say N.

config HWSPINLOCK_OMAP
	tristate "OMAP Hardware Spinlock device"
	depends on HWSPINLOCK && ARCH_OMAP4
	help
	  Say y here to support the OMAP Hardware Spinlock device (firstly
	  introduced in OMAP4).

	  If unsure, say N.
config HWSPINLOCK_SPRD
	tristate "SPRD Hardware Spinlock device"
	depends on HWSPINLOCK && ARCH_SC8825
	help
	  Say y here to support the SPRD Hardware Spinlock device (firstly
	  introduced in tiger socs).

	  If unsure, say N.
```

## drivers/media/atv/nmi601/Kconfig
```kconfig
#
# NMI ATV device configuration
#

config NMI601_ATV
	default n
	---help---
	Choose Y or M here if you have ATV receiver with a NMI chipset.

	To compile this driver as a module, choose M here
	(The modules will be called nmiatv).

	Note: All dependents, if selected, will be part of this module.

	Further documentation on this driver can be found on the WWW at http://www.newportmediainc.com/
```

## drivers/media/mdtv/Kconfig
```kconfig
#
# MDTV device configuration, siano, innofidei ..
#

source "drivers/media/mdtv/maxscend/Kconfig"
```

## drivers/media/mdtv/maxscend/Kconfig
```kconfig
#
# Maxscend Mobile Silicon Digital TV device configuration
#

config MXD_MDTV
	tristate "Maxscend based MDTV receiver"
	default n
	---help---
	Choose Y or M here if you have MDTV receiver with a maxscend chipset.

	To compile this driver as a module, choose M here
	(The modules will be called smsmdtv).

	Note: All dependents, if selected, will be part of this module.
```

## drivers/media/mdtv/siano/Kconfig
```kconfig
#
# Siano Mobile Silicon Digital TV device configuration
#

config SMS_SIANO_MDTV
	tristate "Siano SMS1xxx based MDTV receiver"
	default n
	---help---
	Choose Y or M here if you have MDTV receiver with a Siano chipset.

	To compile this driver as a module, choose M here
	(The modules will be called smsmdtv).

	Note: All dependents, if selected, will be part of this module.

	Further documentation on this driver can be found on the WWW at http://www.siano-ms.com/
```

## drivers/media/video/sprd_dcam/Kconfig
```kconfig
if VIDEO_DCAM_SPRD
choice
	prompt "Camera resolution"
	default CAMERA_5M

config CAMERA_2M
	bool "2M pixels"

config CAMERA_3M
	bool "3M pixels"

config CAMERA_5M
	bool "5M pixels"

config CAMERA_8M
	bool "8M pixels"


endchoice

choice
	prompt "Camera rotation"
	default CAMERA_NO_ROTATION

config CAMERA_ROTATION
	bool "sensor rotation"

config CAMERA_NO_ROTATION
	bool "sensor don't rotate"

endchoice

choice
	prompt "Sensor Output"
	default SENSOR_OUTPUT_YUV

config SENSOR_OUTPUT_RAW
	bool "sensor outputs raw"

config SENSOR_OUTPUT_YUV
	bool "sensor outputs yuv"

endchoice

config DCAM_SENSOR_OV5640
	tristate "Add sensor driver of OV5640"

config DCAM_SENSOR_POS_OV5640
	int "Sensor position of OV5640"
	depends on DCAM_SENSOR_OV5640
	range 1 3
	default 1
	help
	  Sensor position: 1 - back, 2 - front, 3 - both.

config DCAM_SENSOR_OV2640
	tristate "Add sensor driver of OV2640"

config DCAM_SENSOR_POS_OV2640
	int "Sensor position of 2640"
	depends on DCAM_SENSOR_OV2640
	range 1 3
	default 1
	help
	  Sensor position: 1 - back, 2 - front, 3 - both.

config DCAM_SENSOR_OV2655
	tristate "Add sensor driver of OV2655"

config DCAM_SENSOR_POS_OV2655
	int "Sensor position of OV2655"
	depends on DCAM_SENSOR_OV2655
	range 1 3
	default 1
	help
	  Sensor position: 1 - back, 2 - front, 3 - both.

config DCAM_SENSOR_OV2659
	tristate "Add sensor driver of OV2659"

config DCAM_SENSOR_POS_OV2659
	int "Sensor position of OV2659"
	depends on DCAM_SENSOR_OV2659
	range 1 3
	default 1
	help
	  Sensor position: 1 - back, 2 - front, 3 - both.

config DCAM_SENSOR_OV3640
	tristate "Add sensor driver of OV3640"

config DCAM_SENSOR_POS_OV3640
	int "Sensor position of OV3640"
	depends on DCAM_SENSOR_OV3640
	range 1 3
	default 1
	help
	  Sensor position: 1 - back, 2 - front, 3 - both.

config DCAM_SENSOR_OV7660
	tristate "Add sensor driver of OV7660"

config DCAM_SENSOR_POS_OV7660
	int "Sensor position of OV7660"
	depends on DCAM_SENSOR_OV7660
	range 1 3
	default 1
	help
	  Sensor position: 1 - back, 2 - front, 3 - both.

config DCAM_SENSOR_OV7670
	tristate "Add sensor driver of OV7670"

config DCAM_SENSOR_POS_OV7670
	int "Sensor position of OV7670"
	depends on DCAM_SENSOR_OV7670
	range 1 3
	default 1
	help
	  Sensor position: 1 - back, 2 - front, 3 - both.

config DCAM_SENSOR_OV7675
	tristate "Add sensor driver of OV7675"

config DCAM_SENSOR_POS_OV7675
	int "Sensor position of OV7675"
	depends on DCAM_SENSOR_OV7675
	range 1 3
	default 1
	help
	  Sensor position: 1 - back, 2 - front, 3 - both.

config DCAM_SENSOR_OV7690
	tristate "Add sensor driver of OV7690"

config DCAM_SENSOR_POS_OV7690
	int "Sensor position of OV7690"
	depends on DCAM_SENSOR_OV7690
	range 1 3
	default 1
	help
	  Sensor position: 1 - back, 2 - front, 3 - both.

config DCAM_SENSOR_OV9655
	tristate "Add sensor driver of OV9655"

config DCAM_SENSOR_POS_OV9655
	int "Sensor position of OV9655"
	depends on DCAM_SENSOR_OV9655
	range 1 3
	default 1
	help
	  Sensor position: 1 - back, 2 - front, 3 - both.

config DCAM_SENSOR_OV9660
	tristate "Add sensor driver of OV9660"

config DCAM_SENSOR_POS_OV9660
	int "Sensor position of OV9660"
	depends on DCAM_SENSOR_OV9660
	range 1 3
	default 1
	help
	  Sensor position: 1 - back, 2 - front, 3 - both.

config DCAM_SENSOR_GC0309
	tristate "Add sensor driver of GC0309"

config DCAM_SENSOR_POS_GC0309
	int "Sensor position of GC0309"
	depends on DCAM_SENSOR_GC0309
	range 1 3
	default 1
	help
	  Sensor position: 1 - back, 2 - front, 3 - both.

config DCAM_SENSOR_GC0306
	tristate "Add sensor driver of GC0306"

config DCAM_SENSOR_POS_GC0306
	int "Sensor position of GC0306"
	depends on DCAM_SENSOR_GC0306
	range 1 3
	default 1
	help
	  Sensor position: 1 - back, 2 - front, 3 - both.

config DCAM_SENSOR_GC0307
	tristate "Add sensor driver of GC0307"

config DCAM_SENSOR_POS_GC0307
	int "Sensor position of GC0307"
	depends on DCAM_SENSOR_GC0307
	range 1 3
	default 1
	help
	  Sensor position: 1 - back, 2 - front, 3 - both.

config DCAM_SENSOR_GT2005
	tristate "Add sensor driver of GT2005"

config DCAM_SENSOR_POS_GT2005
	int "Sensor position of GT2005"
	depends on DCAM_SENSOR_GT2005
	range 1 3
	default 1
	help
	  Sensor position: 1 - back, 2 - front, 3 - both.

config DCAM_SENSOR_HI253
	tristate "Add sensor driver of HI253"

config DCAM_SENSOR_POS_HI253
	int "Sensor position of HI253"
	depends on DCAM_SENSOR_HI253
	range 1 3
	default 1
	help
	  Sensor position: 1 - back, 2 - front, 3 - both.

config DCAM_SENSOR_HI351
	tristate "Add sensor driver of HI351"

config DCAM_SENSOR_POS_HI351
	int "Sensor position of HI351"
	depends on DCAM_SENSOR_HI351
	range 1 3
	default 1
	help
	  Sensor position: 1 - back, 2 - front, 3 - both.


config DCAM_SENSOR_BG0323
	tristate "Add sensor driver of BG0323"

config DCAM_SENSOR_POS_BG0323
	int "Sensor position of BG0323"
	depends on DCAM_SENSOR_BG0323
	range 1 3
	default 1
	help
	  Sensor position: 1 - back, 2 - front, 3 - both.

config DCAM_SENSOR_S5K5CAGX
	tristate "Add sensor driver of S5K5CAGX"

config DCAM_SENSOR_POS_S5K5CAGX
	int "Sensor position of S5K5CAGX"
	depends on DCAM_SENSOR_S5K5CAGX
	range 1 3
	default 1
	help
	  Sensor position: 1 - back, 2 - front, 3 - both.

config DCAM_SENSOR_S5KA3DFX
	tristate "Add sensor driver of S5KA3DFX"

config DCAM_SENSOR_POS_S5KA3DFX
	int "Sensor position of S5KA3DFX"
	depends on DCAM_SENSOR_S5KA3DFX
	range 1 3
	default 1
	help
	  Sensor position: 1 - back, 2 - front, 3 - both.

config DCAM_SENSOR_SR200PC10
	tristate "Add sensor driver of SR200PC10"

config DCAM_SENSOR_POS_SR200PC10
	int "Sensor position of SR200PC10"
	depends on DCAM_SENSOR_SR200PC10
	range 1 3
	default 1
	help
	  Sensor position: 1 - back, 2 - front, 3 - both.

config DCAM_SENSOR_S5KCCGX
	tristate "Add sensor driver of SRS5KCCGX"

config DCAM_SENSOR_POS_S5KCCGX
	int "Sensor position of S5KCCGX"
	depends on DCAM_SENSOR_S5KCCGX
	range 1 3
	default 1
	help
	  Sensor position: 1 - back, 2 - front, 3 - both.

config NMI601_ATV
	tristate "Add atv driver of NMI601"
	depends on VIDEO_DCAM_SPRD
	help
	  nmi601 sensor device.

endif
```

## drivers/misc/sprd_busmonitor/Kconfig
```kconfig
# to add sprd busmonitor configs
config SPRD_BUSMONITOR_CORE
	tristate "SPRD BusMonitor Core"
	depends on ARCH_SC8825
	default y

config SPRD_BUSMONITOR
	tristate "SPRD BusMonitor Low Level Driver"
	depends on SPRD_BUSMONITOR_CORE=y
	depends on ARCH_SC8825
	default y
	
```

## drivers/misc/sprd_cproc/Kconfig
```kconfig
config SPRD_CPROC
	tristate "SPRD Communication Processor Driver"
	default n

config SPRD_CPROC_NKIF
	bool "Simulate VLX NK Interface"
	depends on SPRD_CPROC
	default n
```

## drivers/sipc/Kconfig
```kconfig
menu "SIPC modules"

config SIPC
	bool "Sprd IPC"
	default n
	help
	  SIPC is a module for spreadtrum AP/CP communicaiton system.

config SIPC_SPIPE
	bool "sprd pipe driver based on SBUF"
	default n
	depends on SIPC
	help
	  This driver is a pipe driver base on SBUF, which create
	  general pipes between AP & CP.

config SIPC_SETH
       bool "Sprd Ethernet driver"
       default n
       depends on SIPC
       help
         This driver supports the Spreadtrum Ethernet based on share
         memory. Say Y here if you want to use it.
endmenu
```
