## drivers/staging/android/Kconfig
```kconfig
menu "Android"

config ANDROID
	bool "Android Drivers"
	default N
	---help---
	  Enable support for various drivers needed on the Android platform

if ANDROID

config ANDROID_BINDER_IPC
	bool "Android Binder IPC Driver"
	default n

config ANDROID_LOGGER
	tristate "Android log driver"
	default n

config ANDROID_PERSISTENT_RAM
	bool
	depends on HAVE_MEMBLOCK
	select REED_SOLOMON
	select REED_SOLOMON_ENC8
	select REED_SOLOMON_DEC8

config ANDROID_RAM_CONSOLE
	bool "Android RAM buffer console"
	depends on !S390 && !UML && HAVE_MEMBLOCK
	select ANDROID_PERSISTENT_RAM
	default n

config PERSISTENT_TRACER
	bool "Persistent function tracer"
	depends on HAVE_FUNCTION_TRACER
	select FUNCTION_TRACER
	select ANDROID_PERSISTENT_RAM
	help
	  persistent_trace traces function calls into a persistent ram
	  buffer that can be decoded and dumped after reboot through
	  /sys/kernel/debug/persistent_trace.  It can be used to
	  determine what function was last called before a reset or
	  panic.

	  If unsure, say N.

config ANDROID_TIMED_OUTPUT
	bool "Timed output class driver"
	default y

config ANDROID_TIMED_GPIO
	tristate "Android timed gpio driver"
	depends on GENERIC_GPIO && ANDROID_TIMED_OUTPUT
	default n

config ANDROID_LOW_MEMORY_KILLER
	bool "Android Low Memory Killer"
	default N
	---help---
	  Register processes to be killed when memory is low

config ANDROID_LOW_MEMORY_KILLER_AUTODETECT_OOM_ADJ_VALUES
	bool "Android Low Memory Killer: detect oom_adj values"
	depends on ANDROID_LOW_MEMORY_KILLER
	default y
	---help---
	  Detect oom_adj values written to
	  /sys/module/lowmemorykiller/parameters/adj and convert them
	  to oom_score_adj values.

config ANDROID_INTF_ALARM_DEV
	bool "Android alarm driver"
	depends on RTC_CLASS
	default n
	help
	  Provides non-wakeup and rtc backed wakeup alarms based on rtc or
	  elapsed realtime, and a non-wakeup alarm on the monotonic clock.
	  Also exports the alarm interface to user-space.

config SYNC
	bool "Synchronization framework"
	default n
	select ANON_INODES
	---help---
	  This option enables the framework for synchronization between multiple
	  drivers.  Sync implementations can take advantage of hardware
	  synchronization built into devices like GPUs.

config SW_SYNC
	bool "Software synchronization objects"
	default n
	depends on SYNC
	---help---
	  A sync object driver that uses a 32bit counter to coordinate
	  syncrhronization.  Useful when there is no hardware primitive backing
	  the synchronization.

config SW_SYNC_USER
	bool "Userspace API for SW_SYNC"
	default n
	depends on SW_SYNC
	---help---
	  Provides a user space API to the sw sync object.
	  *WARNING* improper use of this can result in deadlocking kernel
	  drivers from userspace.

source "drivers/staging/android/ion/Kconfig"

endif # if ANDROID

endmenu
```

## drivers/video/sc8825/Kconfig
```kconfig
config FB_SC8825
	boolean "SC8825 frame buffer support "
	depends on FB && ARCH_SC8825
	select FB_CFB_FILLRECT
	select FB_CFB_COPYAREA
	select FB_CFB_IMAGEBLIT
	help
          Frame buffer driver for sc8825 based boards.

config FB_LCD_HX8362_RGB_SPI
	boolean "support HX8362 rgb (spi) panel"
	depends on FB_SC8825
	default n

config FB_LCD_HX8369
	boolean "support HX8369 panel"
	depends on FB_SC8825
	default n

config FB_LCD_S6D0139
	boolean "support S6D0139 panel"
	depends on FB_SC8825
	default n

config FB_LCD_NT35516_MIPI
	boolean "support NT35516 mipi panel"
	depends on FB_SC8825
	default n

config FB_LCD_NT35516_RGB_I2C
	boolean "support NT35516 rgb (i2c) panel"
	depends on FB_SC8825
	default n

config FB_LCD_NT35516_RGB_SPI
	boolean "support NT35516 rgb (spi) panel"
	depends on FB_SC8825
	default n

config FB_LCD_NT35516_MCU
	boolean "support NT35516 mcu panel"
	depends on FB_SC8825
	default n

config FB_LCD_NT35510_MIPI
	boolean "support NT35510 mipi panel"
	depends on FB_SC8825
	default n

config FB_LCD_NT35512_MIPI
	boolean "support NT35512 mipi panel"
	depends on FB_SC8825
	default n

config FB_LCD_OTM8018B_MIPI
	boolean "support otm 8018b mipi panel"
	depends on FB_SC8825
	default n

config FB_LCD_OVERLAY_SUPPORT
	boolean "support lcd overlay"
	depends on FB_SC8825
	default n
```

## drivers/video/spreadtrum/Kconfig
```kconfig
config FB_SC8810
	boolean "SC8810 frame buffer support "
	depends on FB && ARCH_SC8810
	select FB_CFB_FILLRECT
	select FB_CFB_COPYAREA
	select FB_CFB_IMAGEBLIT
	help
          Frame buffer driver for SC8810 based boards.

config FB_LCD_NOFMARK
	boolean "not support fmark"
	depends on FB_SC8810

config FB_LCD_HX8369
	boolean "support HX8369 panel"
	depends on FB_SC8810

config FB_LCD_HX8369_HVGA_TEST
	boolean "support HX8369 panel"
	depends on FB_LCD_HX8369

config FB_LCD_ILI9486
	boolean "support ILI9486 panel"
	depends on FB_SC8810


config FB_LCD_ILI9341_BOE
        boolean "support ILI9486 panel"
        depends on FB_SC8810

config FB_LCD_ILI9341_BOE_MINT
        boolean "support ILI9486 panel"
        depends on FB_SC8810

config FB_LCD_HX8357
	boolean "support HX8357 panel"
	depends on FB_SC8810

config FB_LCD_RM6158_TRULY
	boolean "support rm6158 truly panel"
	depends on FB_SC8810

config FB_LCD_HX8357_OPENPHONE
	boolean "support HX8357OPENPHONE panel"
	depends on FB_SC8810

config FB_LCD_NT35516
	boolean "support NT35516 panel"
	depends on FB_SC8810

config FB_LCD_OVERLAY_SUPPORT
	boolean "support lcd overlay"
	depends on FB_SC8810
	default n

config FB_LCD_NT35510
	boolean "support nt35510 panel"
	depends on FB_SC8810

config FB_LCD_S6D04H0
	boolean "support s6d04h0 panel"
	depends on FB_SC8810
```
