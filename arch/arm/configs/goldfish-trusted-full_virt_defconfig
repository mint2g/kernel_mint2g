## arch/arm/configs/goldfish-trusted-full_virt_defconfig
```kconfig
CONFIG_EXPERIMENTAL=y
# CONFIG_SWAP is not set
CONFIG_SYSVIPC=y
CONFIG_TREE_PREEMPT_RCU=y
CONFIG_LOG_BUF_SHIFT=14
CONFIG_SYSFS_DEPRECATED_V2=y
CONFIG_BLK_DEV_INITRD=y
CONFIG_INIT_DEV=y
CONFIG_EMBEDDED=y
# CONFIG_KALLSYMS is not set
CONFIG_MODULES=y
CONFIG_MODULE_UNLOAD=y
# CONFIG_BLK_DEV_BSG is not set
CONFIG_ARCH_ARM_OSWARE=y
CONFIG_RAM_PHYS=0x00000000
CONFIG_ONE_SHOT_TIMER=y
CONFIG_CPU_ARM926T=y
CONFIG_NO_HZ=y
CONFIG_HIGH_RES_TIMERS=y
CONFIG_PREEMPT=y
CONFIG_AEABI=y
CONFIG_ZBOOT_ROM_TEXT=0x0
CONFIG_ZBOOT_ROM_BSS=0x0
CONFIG_CMDLINE="mem=32M console=ttyS0,115200n8 noinitrd root=/dev/nfs"
CONFIG_FPE_NWFPE=y
CONFIG_NET=y
CONFIG_PACKET=y
CONFIG_UNIX=y
CONFIG_INET=y
CONFIG_IP_MULTICAST=y
CONFIG_IP_PNP=y
CONFIG_IP_PNP_DHCP=y
CONFIG_IP_PNP_RARP=y
# CONFIG_INET_LRO is not set
# CONFIG_IPV6 is not set
# CONFIG_WIRELESS is not set
CONFIG_UEVENT_HELPER_PATH="/sbin/hotplug"
CONFIG_BLK_DEV_RAM=y
CONFIG_BLK_DEV_RAM_SIZE=8192
# CONFIG_MISC_DEVICES is not set
CONFIG_NETDEVICES=y
# CONFIG_NETDEV_1000 is not set
# CONFIG_NETDEV_10000 is not set
# CONFIG_WLAN is not set
# CONFIG_INPUT_MOUSEDEV is not set
# CONFIG_INPUT_KEYBOARD is not set
# CONFIG_INPUT_MOUSE is not set
# CONFIG_SERIO is not set
CONFIG_LEGACY_PTY_COUNT=32
# CONFIG_HW_RANDOM is not set
# CONFIG_HWMON is not set
# CONFIG_VGA_CONSOLE is not set
# CONFIG_HID_SUPPORT is not set
# CONFIG_USB_SUPPORT is not set
CONFIG_EXT2_FS=y
CONFIG_INOTIFY=y
CONFIG_TMPFS=y
CONFIG_CRAMFS=y
CONFIG_ROMFS_FS=y
CONFIG_NLS=y
CONFIG_NLS_CODEPAGE_437=y
CONFIG_NLS_CODEPAGE_850=y
CONFIG_NLS_ISO8859_1=y
CONFIG_DEBUG_KERNEL=y
# CONFIG_DETECT_SOFTLOCKUP is not set
# CONFIG_SCHED_DEBUG is not set
# CONFIG_DEBUG_PREEMPT is not set
# CONFIG_RCU_CPU_STALL_DETECTOR is not set
CONFIG_SYSCTL_SYSCALL_CHECK=y
CONFIG_DEBUG_ERRORS=y
# CONFIG_CRYPTO_ANSI_CPRNG is not set
# CONFIG_CRC32 is not set
```

## arch/arm/mach-osware/Kconfig
```kconfig
#
#  Copyright (C) 2011, Red Bend Ltd.
#
#  This program is free software: you can redistribute it and/or modify
#  it under the terms of the GNU General Public License Version 2
#  as published by the Free Software Foundation.
#
#  This program is distributed in the hope that it will be useful,
#  but WITHOUT ANY WARRANTY; without even the implied warranty of
#  MERCHANTABILITY or FITNESS FOR A PARTICULAR PURPOSE.
#
#  You should have received a copy of the GNU General Public License Version 2
#  along with this program. If not, see <http://www.gnu.org/licenses/>.
#

comment "Generic ARM OSware Machine Options"
	depends on ARCH_ARM_OSWARE

config MACH_ARM_OSWARE
	bool
	depends on ARCH_ARM_OSWARE
	default y

config BOARD_NAME
	string "Board name"
	depends on MACH_ARM_OSWARE
	default ""
	help
	  The name of the target board

config MACH_ARM_64_BYTES_L1_CACHE_LINE
	bool "CPU uses 64 bytes L1 cache lines"
	depends on MACH_ARM_OSWARE && CPU_V7
	default y
	select ARM_L1_CACHE_SHIFT_6 if MACH_ARM_64_BYTES_L1_CACHE_LINE

config ARCH_SUPPORTS_BIG_ENDIAN
	bool
        depends on MACH_ARM_OSWARE && (CPU_V6 || CPU_V7)
	default y

config RAM_PHYS
        hex "Physical RAM base address"
	depends on MACH_ARM_OSWARE
        default "0"
        help
          The physical start address of the RAM area.

config ONE_SHOT_TIMER
	bool "Use new one shot virtual timer"
	depends on MACH_ARM_OSWARE
	default y
	select GENERIC_TIME
	select GENERIC_CLOCKEVENTS

config HZ
        int "Tick frequency"
	depends on MACH_ARM_OSWARE && !ONE_SHOT_TIMER
        default "100"
        help
          The frequency of the system tick.
```

## arch/arm/mach-sc8810/Kconfig
```kconfig
if ARCH_SC8810

comment "SC8810 Board Type"

config ARCH_SC7710
	bool "SPREADTRUM SC7710"
	help
	  Support for Spreadtrum sc7710 based systems.

choice
	prompt "SC8810 Board"

config MACH_OPENPHONE_SC6820
       default n
       bool "6820 OpenPhone"
       help
         6820 openphone board based on SC8810.

config MACH_SP8810EA
	default n
	bool "SP8810EA Phone"
	help
	  SP8810EA phone board based on SC8810.

config MACH_SP8810EB
	default n
	bool "SP8810EB Phone"
	help
	  SP8810EB phone board based on SC8810.

config MACH_SP8810EC
	default n
	bool "SP8810EC Phone"
	help
	  SP8810EC phone board based on SC8810.

config MACH_SP8810GA
	default n
	bool "SP8810GA Phone"
	help
	  SP8810GA phone board based on SC8810.

config MACH_SP8810GB
	default n
	bool "SP8810GB Phone"
	help
	  SP8810GB phone board based on SC8810.

config MACH_SP6820GA
	default n
	bool "SP6820GA Phone"
	help
	  SP6820GA phone board based on SC8810.

config MACH_AMAZING
	default n
	bool "AMAZING Phone"
	help
	  AMAZING phone board based on SC8810.

config MACH_MINT
	default n
	bool "MINT Phone"
	help
	  MINT phone board based on SC6820.

config MACH_KYLETD
	default n
	bool "KYLETD Phone"
	help
	  KYLETD phone board based on SC8810.

config MACH_KYLEW
	default n
	bool "KYLEW Phone"
	help
	  KYLETD phone board based on SC8810.


config MACH_Z788
	default n
	bool "Z788 Phone"
	help
	  Z788 phone board based on SC8810.

config MACH_SP7710G_OPENPHONE
	select ARCH_SC7710
	bool "SP7710G fpga and openphone board"
	help
	  SP7710G fpga and openphone based on ARCH_SC7710.

config MACH_SP7702
	default n
	bool "SP7702 phone"
	help
	  SP7702 phone board base on SC8810 with sc7701 modem.

endchoice

config SPRD_PMEM_SIZE
        int "size for /dev/pmem"
        range 1 16
        default 8
	depends on ANDROID_PMEM

config SPRD_PMEM_ADSP_SIZE
        int "size for /dev/pmem_adsp"
        range 1 64
        default 22
	depends on ANDROID_PMEM

config SPRD_ION_SIZE
        int "size for /dev/ion"
        range 1 64
        default 24
	depends on ION

config SPRD_ION_OVERLAY_SIZE
        int "size for /dev/ion"
        range 0 64
        default 0
	depends on ION

config SC8810_VIBRATOR
        depends on ARCH_SC8810
        select ANDROID_TIMED_OUTPUT
        default n
        bool "vibrator for SC8810"

config SS_VIBRATOR
        depends on ARCH_SC8810
        select ANDROID_TIMED_OUTPUT
        default n
        bool "SS vibrator for SC8810"

config SPRD_MEM_POOL
	depends on ARCH_SC8810
	default n
        bool "Using a memory pool to alloc thread stack and pgd table"
	help
          This option enables memmory pool for allocating thread stack and pgd table.

config SPRD_DCDC_DEBUG
	depends on ARCH_SC8810
	default y
    tristate "Enable dcdc debug module"
	help
          This option select dcdc debug module.

config SC8810_DDR_6G
        depends on ARCH_SC8810
        default n
        bool "SC8810 feature to use 6Gb DDR"

endif
```

## arch/arm/mach-sc8825/Kconfig
```kconfig
if ARCH_SC8825

comment "SC8825 Board Type"

choice
	prompt "SC8825 Board"

config MACH_SP8825_FPGA
	bool "SP8825 FPGA"
	help
	  SP8825 FPGA board based on SC8825.
config MACH_SP8825_OPENPHONE
	bool "SP8825 OPENPHONE"
	help
	  SP8825 OPENPHONE board based on SC8825.
config MACH_SP8825GA_OPENPHONE
	bool "SP8825GA OPENPHONE (NAND)"
	help
	  SP8825 OPENPHONE board based on SC8825.
config MACH_SP8825EA
	bool "SP8825EA"
	help
	  SP8825 EA based on SC8825.
config MACH_SP8825EB
	bool "SP8825EB"
	help
	  SP8825 EB based on SC8825.
config MACH_SP6825GA
	bool "SP6825GA"
	help
	  SP6825 GA based on SC8825.
config MACH_GARDA
	bool "GARDA"
	help
	  GARDA based on SC8825.
endchoice

config SPRD_PMEM_SIZE
        int "size for /dev/pmem"
        range 1 16
        default 8
	depends on ANDROID_PMEM
config SPRD_PMEM_ADSP_SIZE
        int "size for /dev/pmem_adsp"
        range 1 64
        default 22
	depends on ANDROID_PMEM

config SPRD_ION_SIZE
        int "size for ion"
        range 1 64
        default 1
	depends on ION
config SPRD_ION_OVERLAY_SIZE
        int "size for ion overlay"
        range 1 64
        default 1
	depends on ION

config SC8825_VIBRATOR
        depends on ARCH_SC8825
        select ANDROID_TIMED_OUTPUT
        default n
        bool "vibrator for SC8825"

config SPRD_MEM_POOL
	depends on ARCH_SC8825
	default y
        bool "Using a memory pool to alloc thread stack and pgd table"
	help
          This option enables memmory pool for allocating thread stack and pgd table.

config SPRD_DCDC_DEBUG
	default y
	tristate "Enable dcdc debug module"
	help
		This option select dcdc debug module.
endif
```

## arch/arm/nkernel/Kconfig
```kconfig
#
#  Copyright (C) 2011, Red Bend Ltd.
#
#  This program is free software: you can redistribute it and/or modify
#  it under the terms of the GNU General Public License Version 2
#  as published by the Free Software Foundation.
#
#  This program is distributed in the hope that it will be useful,
#  but WITHOUT ANY WARRANTY; without even the implied warranty of
#  MERCHANTABILITY or FITNESS FOR A PARTICULAR PURPOSE.
#
#  You should have received a copy of the GNU General Public License Version 2
#  along with this program. If not, see <http://www.gnu.org/licenses/>.
#

# Copyright (c) 2016 Psych Half, <psych.half@gmail.com>
# Modified to add a menu, makes menuconfig cleaner


menu "VLX virtualizer"

config NKERNEL
	bool "VLX virtualizer support"
	default n

if NKERNEL

config NKERNEL_DDI
	bool "VLX virtual driver support"
	default y

config NKERNEL_DDI_APICHECK
	bool "VLX virtual driver API call check"
	depends on NKERNEL_DDI
	default n

config RELOCATABLE_KERNEL
 	bool "Build relocatable linux kernel"
 	default	y  if NKERNEL

config NKERNEL_DYNAMIC_GUEST_LOADING
	bool "VLX dynamic guest loading support"
	default n

config NKERNEL_ARCH_PM_MASTER
	bool "Power Manage by Linux"
	help
	  Select this option for a platform to enable NKERNEL_PM_MASTER option.

config NKERNEL_PM_MASTER
	bool "VLX Power Management Master"
	depends on NKERNEL && NKERNEL_ARCH_PM_MASTER
	default y
	help
	  Select this option to delegate to this guest OS the global
	  platform power management. In order to behave correctly,
	  this guest OS has to be running on all physical cores with
	  disabled migration. In addition, this guest OS has to be running
	  on a highest priority and it has to park physical cores.

config NKERNEL_PM_GLOBAL_SUSPEND
	bool "VLX Global Suspend to RAM"
	depends on NKERNEL_PM_MASTER
	default y
	help
	  Select this option in order to suspend to RAM the physical
	  platform only when all VMs are virtually suspended.

config NKERNEL_MUX_IO
	bool "VLX vonsole IO interface for ts0710mux"
	default y
	help
	  This option is used to support io interface for ts0710mux driver.
endif

config TEXT_OFFSET
	hex  "Text offset configuration"
	default 0x00008000

endmenu
```

## drivers/cpufreq/Kconfig.default_governor
```kconfig
config CPU_FREQ_DEFAULT_GOV_SMARTASS2
        bool "smartass2"
        select CPU_FREQ_GOV_SMARTASS2
        help
          Use the CPUFreq governor 'smartassV2' as default.

config CPU_FREQ_DEFAULT_GOV_WHEATLEY
	bool "wheatley"
	select CPU_FREQ_GOV_WHEATLEY
	select CPU_FREQ_GOV_PERFORMANCE
	help
          Use the CPUFreq governor 'wheatley' as default.

config CPU_FREQ_DEFAULT_GOV_LAGFREE
	bool "lagfree"
	select CPU_FREQ_GOV_LAGFREE
	select CPU_FREQ_GOV_PERFORMANCE
	---help---
	  Use the CPUFreq governor 'lagfree' as default. This allows
	  you to get a full dynamic frequency capable system by simply
	  loading your cpufreq low-level hardware driver.
	  Be aware that not all cpufreq drivers support the lagfree
	  governor. If unsure have a look at the help section of the
	  driver. Fallback governor will be the performance governor.

config CPU_FREQ_DEFAULT_GOV_ONDEMANDX
	bool "ondemandX"
	select CPU_FREQ_GOV_ONDEMANDX
	select CPU_FREQ_GOV_PERFORMANCE
	help
	  Use the CPUFreq governor 'ondemand' as default. This allows
	  you to get a full dynamic frequency capable system by simply
	  loading your cpufreq low-level hardware driver.
	  Be aware that not all cpufreq drivers support the ondemand
	  governor. If unsure have a look at the help section of the
	  driver. Fallback governor will be the performance governor.
	  OndemandX has built in sleep profile, but not working Sysfs
	  interface.

config CPU_FREQ_DEFAULT_GOV_ONDEMANDPLUS
  bool "ondemandplus"
  select CPU_FREQ_GOV_ONDEMANDPLUS
  select CPU_FREQ_GOV_PERFORMANCE
  help
  Use the CPUFreq governor 'ondemandplus' as default. This allows
  you to get a full dynamic frequency capable system by simply
  loading your cpufreq low-level hardware driver.
  Be aware that not all cpufreq drivers support the ondemandplus
  governor. If unsure have a look at the help section of the
  driver. Fallback governor will be the performance governor.
 
 
config CPU_FREQ_DEFAULT_GOV_INTELLIDEMAND
  bool "intellidemand"
  select CPU_FREQ_GOV_INTELLIDEMAND
  help
  Use the CPUFreq governor 'intellidemand' as default. This is
  based on Ondemand with browsing detection based on GPU loading
 
 
config CPU_FREQ_DEFAULT_GOV_INTELLIACTIVE
  bool "intelliactive"
  select CPU_FREQ_GOV_INTELLIACTIVE
  help
  Use the CPUFreq governor 'intelliactive' as default. This allows
  you to get a full dynamic cpu frequency capable system by simply
  loading your cpufreq low-level hardware driver, using the
  'interactive' governor for latency-sensitive workloads.
 
 
config CPU_FREQ_DEFAULT_GOV_LIONHEART
  bool "lionheart"
  select CPU_FREQ_GOV_LIONHEART
  help
  Use the CPUFreq governor 'lionheart' as default.

config CPU_FREQ_DEFAULT_GOV_VIRTOUS
	bool "virtous"
	select CPU_FREQ_GOV_VIRTOUS
	select CPU_FREQ_GOV_PERFORMANCE
	help
	  Use the CPUFreq governor 'virtous' as default. Fallback governor will be the performance governor.

config CPU_FREQ_DEFAULT_GOV_LULZACTIVE
	bool "lulzactive2"
	select CPU_FREQ_GOV_LULZACTIVE
	help
	  Use the CPUFreq governor 'lulzactive2' as default. This option enables
	  CPUFReq governor lulzactive.
```
